## boards/arm/AB0001/Kconfig.AB0001
```kconfig
# Copyright (c) 2024 Nordic Semiconductor ASA
# SPDX-License-Identifier: Apache-2.0

config BOARD_AB0001
	select SOC_NRF54L15_CPUAPP if BOARD_AB0001_NRF54L15_CPUAPP
	
```

## boards/arm/AB0001/board.yml
```yaml
board:
  name: AB0001
  full_name: AB0001
  vendor: abus
  socs:
  - name: nrf54l15
    variants:
    - name: xip
      cpucluster: cpuflpr
```

## boards/arm/BORDO6000CB/Kconfig.BORDO6000CB
```kconfig
# nRF52 DK nRF52810 board configuration

# Copyright (c) 2018 Nordic Semiconductor ASA
# SPDX-License-Identifier: Apache-2.0

config BOARD_BORDO6000CB
	select SOC_NRF52832_QFAA if BOARD_BORDO6000CB_NRF52832
```

## boards/arm/BORDO6000CB/board.yml
```yaml
board:
  name: BORDO6000CB
  full_name: BORDO6000CB
  vendor: nordic
  socs:
  - name: nrf52805
  - name: nrf52810
  - name: nrf52832
```

## boards/arm/CFF4100V0P6/board.yml
```yaml
board:
  name: CFF4100V0P6
  full_name: CFF4100V0.6
  vendor: nordic
  socs:
   - name: nrf52832
```

## boards/arm/CFF4100V0P6_ANNAB5/Kconfig.CFF4100V0P6
```kconfig
# CFF4100V0.6 board configuration

# Copyright (c) 2018 Nordic Semiconductor ASA
# SPDX-License-Identifier: Apache-2.0

config BOARD_CFF4100V0P6
	select SOC_NRF52832_QFAA if BOARD_CFF4100V0P6_NRF52832
```

## boards/arm/CFF4100V0P6_ANNAB5/board.yml
```yaml
board:
  name: CFF4100V0P6_ANNAB5
  full_name: CFF4100V0.6
  vendor: nordic
  socs:
   - name: nrf52832
```

## boards/arm/cfh4100/Kconfig.cfh4100
```kconfig
# nRF52 DK nRF52810 board configuration

# Copyright (c) 2018 Nordic Semiconductor ASA
# SPDX-License-Identifier: Apache-2.0

config BOARD_CFH4100	
    select SOC_NRF52832_QFAA if BOARD_CFH4100_NRF52832
```

## boards/arm/nrf52nfc/Kconfig.nrf52nfc
```kconfig
# nRF52 DK nRF52810 board configuration

# Copyright (c) 2018 Nordic Semiconductor ASA
# SPDX-License-Identifier: Apache-2.0

config BOARD_NRF52NFC
	select SOC_NRF52832_QFAA if BOARD_NRF52NFC_NRF52832
```

## boards/arm/nrf52nfc/board.yml
```yaml
board:
  name: nrf52nfc
  full_name: nRF52 DK
  vendor: nordic
  socs:
  - name: nrf52805
  - name: nrf52810
  - name: nrf52832
```
